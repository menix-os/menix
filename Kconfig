## Kconfig
```kconfig
mainmenu "Menix Build Configuration"

source "kernel/Kconfig"
source "drivers/Kconfig"
```

## drivers/Kconfig
```kconfig
menu "Drivers"

source "drivers/acpi/Kconfig"

config EXAMPLE
  tristate "Example driver"
  default m
  help
    Says hello world on the console.

endmenu
```

## drivers/acpi/Kconfig
```kconfig
menuconfig ACPI
  bool "Advanced Configuration and Power Interface"
  default y
  depends on X86_64 || AARCH64 || RISCV64 || LOONGARCH64
  help
    Enables ACPI firmware support.

if ACPI

endif
```

## kernel/Kconfig
```kconfig
menu "Kernel"

menuconfig MODULES
  bool "Dynamic modules"
  default y
  help
    Enables build support for dynamically loaded modules.
    Modules are shared objects that can link against the kernel at runtime.

menu "$(ARCH) Architecture"
source "kernel/arch/$(ARCH)/Kconfig"
endmenu

source "kernel/boot/Kconfig"

source "kernel/mem/Kconfig"

endmenu
```

## kernel/boot/Kconfig
```kconfig
menu "Boot"

config BOOT_LIMINE
  bool "Limine boot protocol"
  default y
  help
    Use the Limine boot protocol to start the kernel.

config BOOT_UEFI
  bool "UEFI application emulation"
  depends on X86_64 || AARCH64 || RISCV64 || LOONGARCH64
  default n
  help
    Imitate an EFI binary and use that as an entry point.

endmenu
```

## kernel/mem/Kconfig
```kconfig
menu "Memory Management"

menu "kmalloc implementation"

config SLAB
  bool "SLAB"
  default y
  help
    Uses SLAB as the default memory allocator for kernel objects.

endmenu

endmenu
```
